/*
 * Copyright (C) 2020 - 2023 Semtech, Inc.
 *
 * $Revision: 1 $
 * $Date: 2023-02-21 $
 *
 * This program is free software; you can redistribute it and/or modify
 * it under the terms of the GNU General Public License as published by
 * the Free Software Foundation; either version 2 of the License, or
 * (at your option) any later version.
 *
 * This program is distributed in the hope that it will be useful, but WITHOUT
 * ANY WARRANTY; without even the implied warranty of MERCHANTABILITY or
 * FITNESS FOR A PARTICULAR PURPOSE.  See the GNU General Public License for
 * more details.
 *
 */

&i2c0 {
    sx933x@28 {
        compatible = "Semtech,sx933x";
        reg = <0x28>;
        status = "okay";

        Semtech,nirq-gpio = <&pio 14 0>; /* IRQ */
        /*Tab A9 code for SR-AX6739A-01-309|SR-AX6739A-01-751|AX6739A-1280 by xiongxiaoliang at 20230619 start*/
        Semtech,main-phases = <0x0e>;
        Semtech,ref-phases = <0x11>;
        /*Tab A9 code for AX6739A-2359 by lichang at 20230720 start*/
        /*Tab A9_na code for AX6739NU-118 by zhawei at 20241209 start*/
	/*Tab A9_na code for AX6739NU-149 by liuyiying at 20241227 start*/
        Semtech,fw-num = <230619>;
        /*Tab A9 code for SR-AX6739A-01-309|SR-AX6739A-01-751|AX6739A-1280 by xiongxiaoliang at 20230619 end*/
        /*Tab A9 code for AX6739A-413|AX6739A-627|AX6739A-1280 by xiongxiaoliang at 20230619 start*/
        /*Tab A9 code for AX6739A-793|AX6739A-1116 by lichang at 20230613 start*/
        Semtech,reg-num = <43>;
        Semtech,reg-init = <
            0x8020 0x001E0000
            0x4004 0x00000070
            0x801C 0x00000031
            0x8024 0x10000A8E
            0x8028 0x24928349
            0x802C 0x10000A96
            0x8030 0x24963565
            0x8034 0x10000A8E
            0x8038 0x24B202CE
            0x803C 0x10000AAE
            0x8040 0x25920351
            0x8044 0x10000AAE
            0x8048 0x2C9203D9
            0x804C 0x0000088E
            0x8050 0x80001EE6
            0x8054 0x1652FF00
            0x8058 0x20630030
            0x805C 0x00005300
            0x8074 0x10320E00
            0x8078 0x20630060
            0x807C 0x03003000
            0x808C 0x00100010
            0x8090 0x10022805
            0x8094 0x10323700
            0x8098 0x20600360
            0x809C 0x06003000
            0x80AC 0x001E001E
            0x80B0 0x00020000
            0x80B4 0x10321F00
            0x80B8 0x20630360
            0x80BC 0x04003000
            0x80CC 0x00350035
            0x80D0 0x00020000
            0x80D4 0x1622FF05
            0x80D8 0x20200060
            0x80DC 0x00005300
            0x80F4 0x10162800
            0x80F8 0x20400031
            0x80FC 0x54AC5300
            0x8124 0x04000008
            0x8128 0x0400000C
            0x8020 0x001E001E
            0x4280 0x0000000F
        >;
	/*Tab A9_na code for AX6739NU-149 by liuyiying at 20241227 end*/
        /*Tab A9_na code for AX6739NU-118 by zhawei at 20241209 end*/
        /*Tab A9 code for AX6739A-2359 by lichang at 20230720 end*/
        /*Tab A9 code for AX6739A-793|AX6739A-1116 by lichang at 20230613 end*/
        /*Tab A9 code for AX6739A-413|AX6739A-627|AX6739A-1280 by xiongxiaoliang at 20230619 end*/
    };
};
